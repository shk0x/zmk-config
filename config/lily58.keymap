/*
* Copyright (c) 2020 The ZMK Contributors
*
* SPDX-License-Identifier: MIT
*/

#include <behaviors.dtsi>
#include <dt-bindings/zmk/keys.h>
#include <dt-bindings/zmk/bt.h>
#include <dt-bindings/zmk/ext_power.h>

/ {
keymap {
	compatible = "zmk,keymap";
layer0 {
		bindings = <
		&kp GRAVE &kp N1 &kp N2 &kp N3 &kp N4 &kp N5 &kp N6 &kp N7 &kp N8 &kp N9 &kp N0 &kp BACKSPACE &kp TAB &kp Q &kp W &kp E &kp R &kp T &kp Y &kp U &kp I &kp O &kp P &kp BACKSLASH &kp LEFT_SHIFT &kp A &kp S &kp D &kp F &kp G &kp H &kp J &kp K &kp L &kp SEMICOLON &kp SINGLE_QUOTE &kp LEFT_CONTROL &kp Z &kp X &kp C &kp V &kp B &kp LEFT_BRACKET &kp RIGHT_BRACKET &kp N &kp M &kp COMMA &kp DOT &kp SLASH &kp EQUAL &kp LEFT_ALT &kp LEFT_GUI &mo 1 &kp SPACE &kp ENTER &kp PRINTSCREEN &kp MINUS &kp C_MUTE
		>;
	};layer1 {
		bindings = <
		&kp ESCAPE &bt BT_SEL 0 &bt BT_SEL 1 &bt BT_SEL 2 &bt BT_SEL 3 &bt BT_SEL 4 &bt BT_CLR &kp F20 &kp F20 &kp F20 &kp F20 &kp DELETE &kp F1 &kp F2 &kp F3 &kp F4 &kp F5 &kp F6 &kp F7 &kp F8 &kp F9 &kp F10 &kp F11 &kp F12 &kp RIGHT_SHIFT &kp F20 &kp F20 &kp F20 &kp F20 &kp F20 &kp F20 &kp F20 &kp F20 &kp F20 &kp UP &kp F20 &kp RIGHT_CONTROL &kp F20 &kp F20 &kp F20 &kp F20 &kp F20 &kp C_VOLUME_UP &kp PAGE_UP &kp F20 &kp F20 &kp F20 &kp LEFT &kp DOWN &kp RIGHT &kp F20 &kp F20 &kp F20 &kp C_VOLUME_DOWN &kp PAGE_DOWN &kp C_PLAY_PAUSE &kp C_PREVIOUS &kp C_NEXT
		>;
	};
};
};
